## boards/native/intuitiv/board.yml
```yaml
board:
  extend: native_sim
  variants:
    - name: intuitiv
      qualifier: native
```

## boards/vendor/intuitiv/Kconfig.intuitiv
```kconfig
# SPDX-License-Identifier: Apache-2.0

config BOARD_INTUITIV
	select SOC_STM32F412RX
```

## boards/vendor/intuitiv/board.yml
```yaml
# SPDX-License-Identifier: Apache-2.0

board:
  name: intuitiv
  full_name: Intuitiv pilot-wire gateway
  vendor: vendor
  socs:
    - name: stm32f412rx
```

## drivers/Kconfig
```kconfig
# SPDX-License-Identifier: Apache-2.0

menu "intuitiv drivers"
rsource "sdhc/Kconfig"
endmenu
```

## drivers/sdhc/Kconfig
```kconfig
# SPDX-License-Identifier: Apache-2.0

config SDHC_STM32F4_SDIO
	bool "STM32F4 SDIO host (SDIO cards)"
	default y
	depends on DT_HAS_ST_STM32F4_SDIO_ENABLED
	depends on SDHC
	select SDHC_SUPPORTS_NATIVE_MODE
	select PINCTRL
	help
	  SD host driver for the SDIO (v1) peripheral of the STM32F4, which
	  the upstream SDMMC driver does not cover.
```

## dts/bindings/sdhc/st,stm32f4-sdio.yaml
```yaml
# SPDX-License-Identifier: Apache-2.0

description: STM32F4 SDIO host controller (SDIO v1 IP, no IDMA)

compatible: "st,stm32f4-sdio"

include: [sdhc.yaml, pinctrl-device.yaml, reset-device.yaml]

properties:
  reg:
    required: true

  clocks:
    required: true

  interrupts:
    required: true

  pinctrl-0:
    required: true

  pinctrl-names:
    required: true

  bus-width:
    type: int
    default: 4
    enum: [1, 4]
    description: Data lines wired to the card
```

## west.yml
```yaml
# SPDX-License-Identifier: Apache-2.0

manifest:
  remotes:
    - name: zephyrproject-rtos
      url-base: https://github.com/zephyrproject-rtos

  projects:
    - name: zephyr
      remote: zephyrproject-rtos
      revision: v4.5.0
      import:
        name-allowlist:
          - cmsis      # required by the ARM port
          - cmsis_6    # Cortex-M CMSIS headers
          - hal_stm32
          - hal_infineon  # AIROC Bluetooth HCD glue (AP6212)
          - mbedtls       # PSA crypto for the Bluetooth host
          - tf-psa-crypto
```
