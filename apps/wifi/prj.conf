## CMakeLists.txt
```
# SPDX-License-Identifier: Apache-2.0

cmake_minimum_required(VERSION 3.20.0)
find_package(Zephyr REQUIRED HINTS $ENV{ZEPHYR_BASE})
project(wifi)

target_sources(app PRIVATE src/main.c src/whd_resources.c)

# Wi-Fi firmware and NVRAM, kept untracked in fw/ (see the README)
set(fw_bin ${CMAKE_CURRENT_SOURCE_DIR}/${CONFIG_INTUITIV_WIFI_FW})
set(nvram_txt ${CMAKE_CURRENT_SOURCE_DIR}/${CONFIG_INTUITIV_WIFI_NVRAM})
set(gen_dir ${ZEPHYR_BINARY_DIR}/include/generated)
if(NOT EXISTS ${fw_bin} OR NOT EXISTS ${nvram_txt})
  message(FATAL_ERROR "Missing ${fw_bin} or ${nvram_txt}, see the README Wi-Fi section")
endif()
generate_inc_file_for_target(app ${fw_bin} ${gen_dir}/wifi_fw.inc)

# NVRAM text -> "key=value\0" C string, the format WHD downloads
set_property(DIRECTORY APPEND PROPERTY CMAKE_CONFIGURE_DEPENDS ${nvram_txt})
file(STRINGS ${nvram_txt} nvram_lines)
set(nvram_c "")
foreach(line IN LISTS nvram_lines)
  string(STRIP "${line}" line)
  if(line STREQUAL "" OR line MATCHES "^#")
    continue()
  endif()
  string(REPLACE "\\" "\\\\" line "${line}")
  string(REPLACE "\"" "\\\"" line "${line}")
  string(APPEND nvram_c "\t\"${line}\\0\"\n")
endforeach()
file(CONFIGURE OUTPUT ${gen_dir}/wifi_nvram_image_data.h CONTENT
  "/* Generated from ${CONFIG_INTUITIV_WIFI_NVRAM} */\nstatic const char wifi_nvram_image[] =\n${nvram_c}\t\"\";\n")
```

## Kconfig
```
# SPDX-License-Identifier: Apache-2.0

config INTUITIV_WIFI_FW
	string "Wi-Fi firmware image, relative to the app"
	default "fw/43430a0-7.45.96.88.bin"

config INTUITIV_WIFI_NVRAM
	string "Wi-Fi NVRAM text, relative to the app"
	default "fw/nvram_ap6212.txt"

config INTUITIV_WIFI_SSID
	string "Network to join after the scan (empty: scan only)"
	default ""

config INTUITIV_WIFI_PSK
	string "WPA2 passphrase"
	default ""

source "Kconfig.zephyr"
```

## prj.conf
```kconfig
CONFIG_LOG=y

CONFIG_NETWORKING=y
CONFIG_NET_IPV4=y
CONFIG_NET_IPV6=n
CONFIG_NET_TCP=y
CONFIG_NET_UDP=y
CONFIG_NET_DHCPV4=y
CONFIG_NET_MGMT_EVENT_INFO=y
CONFIG_NET_MGMT_EVENT_QUEUE_SIZE=16
CONFIG_NET_MGMT_EVENT_QUEUE_TIMEOUT=5000
CONFIG_ENTROPY_GENERATOR=y

CONFIG_WIFI=y
CONFIG_WIFI_LOG_LEVEL_INF=y
# AP6212 = BCM43430A0, firmware and NVRAM from fw/ (whd_resources.c)
CONFIG_AIROC_WIFI_CUSTOM=y
CONFIG_SDIO_STACK=y

CONFIG_MAIN_STACK_SIZE=4096
CONFIG_NET_TX_STACK_SIZE=2048
CONFIG_NET_RX_STACK_SIZE=2048
CONFIG_NET_PKT_RX_COUNT=10
CONFIG_NET_PKT_TX_COUNT=10
CONFIG_NET_BUF_RX_COUNT=20
CONFIG_NET_BUF_TX_COUNT=20

# Exception to the no-heap rule: the vendor WHD driver and its RTOS
# abstraction allocate with k_malloc. Our code stays static.
CONFIG_HEAP_MEM_POOL_SIZE=49152
```

## src/main.c
```c
/*
 * SPDX-License-Identifier: Apache-2.0
 *
 * Wi-Fi bring-up on the AP6212: scan and log the networks, then join
 * CONFIG_INTUITIV_WIFI_SSID (if set), wait for a DHCP address and ping 8.8.8.8.
 */

#include <zephyr/kernel.h>
#include <zephyr/logging/log.h>
#include <zephyr/net/net_if.h>
#include <zephyr/net/net_mgmt.h>
#include <zephyr/net/wifi_mgmt.h>
#include <zephyr/net/dhcpv4.h>
#include <zephyr/net/icmp.h>

LOG_MODULE_REGISTER(main, LOG_LEVEL_INF);

static struct net_mgmt_event_callback wifi_cb, ipv4_cb;
static K_SEM_DEFINE(scan_done, 0, 1);
static K_SEM_DEFINE(connected, 0, 1);
static K_SEM_DEFINE(bound, 0, 1);
static K_SEM_DEFINE(pong, 0, 1);
static int found;

static void wifi_event(struct net_mgmt_event_callback *cb, uint64_t event, struct net_if *iface)
{
	if (event == NET_EVENT_WIFI_SCAN_RESULT) {
		const struct wifi_scan_result *r = cb->info;

		LOG_INF("%-32.*s ch %2u %4d dBm %s", r->ssid_length, r->ssid, r->channel, r->rssi,
			wifi_security_txt(r->security));
		found++;
	} else if (event == NET_EVENT_WIFI_SCAN_DONE) {
		k_sem_give(&scan_done);
	} else if (event == NET_EVENT_WIFI_CONNECT_RESULT) {
		const struct wifi_status *s = cb->info;

		LOG_INF("connect result %d", s->status);
		if (!s->status) {
			k_sem_give(&connected);
		}
	}
}

static void ipv4_event(struct net_mgmt_event_callback *cb, uint64_t event, struct net_if *iface)
{
	char buf[NET_IPV4_ADDR_LEN];

	for (int i = 0; i < NET_IF_MAX_IPV4_ADDR; i++) {
		struct net_if_addr *a = &iface->config.ip.ipv4->unicast[i].ipv4;

		if (a->is_used && a->addr_type == NET_ADDR_DHCP) {
			LOG_INF("DHCP address %s",
				net_addr_ntop(AF_INET, &a->address.in_addr, buf, sizeof(buf)));
			k_sem_give(&bound);
		}
	}
}

static enum net_verdict ping_reply(struct net_icmp_ctx *ctx, struct net_pkt *pkt,
				   struct net_icmp_ip_hdr *ip_hdr, struct net_icmp_hdr *icmp_hdr,
				   void *user_data)
{
	k_sem_give(&pong);
	return NET_OK;
}

static void ping(struct net_if *iface, const char *host, int count)
{
	struct net_sockaddr_in dst = {.sin_family = NET_AF_INET};
	struct net_icmp_ctx ctx;
	int ok = 0;

	net_addr_pton(NET_AF_INET, host, &dst.sin_addr);
	if (net_icmp_init_ctx(&ctx, NET_AF_INET, NET_ICMPV4_ECHO_REPLY, 0, ping_reply)) {
		LOG_ERR("no ICMP context");
		return;
	}
	for (int i = 0; i < count; i++) {
		struct net_icmp_ping_params params = {.sequence = i, .data_size = 32};
		int64_t t = k_uptime_get();
		int err = net_icmp_send_echo_request(&ctx, iface, (struct net_sockaddr *)&dst,
						     &params, NULL);

		if (err) {
			LOG_ERR("ping %s seq %d: send failed (%d)", host, i, err);
		} else if (k_sem_take(&pong, K_SECONDS(2))) {
			LOG_WRN("ping %s seq %d: timeout", host, i);
		} else {
			LOG_INF("ping %s seq %d: %lld ms", host, i, k_uptime_get() - t);
			ok++;
		}
		k_sleep(K_SECONDS(1));
	}
	LOG_INF("ping %s: %d/%d replies", host, ok, count);
	net_icmp_cleanup_ctx(&ctx);
}

int main(void)
{
	struct net_if *iface = net_if_get_wifi_sta();
	int err;

	if (!iface) {
		LOG_ERR("no Wi-Fi interface");
		return 0;
	}

	net_mgmt_init_event_callback(&wifi_cb, wifi_event,
				     NET_EVENT_WIFI_SCAN_RESULT | NET_EVENT_WIFI_SCAN_DONE |
					     NET_EVENT_WIFI_CONNECT_RESULT);
	net_mgmt_add_event_callback(&wifi_cb);
	net_mgmt_init_event_callback(&ipv4_cb, ipv4_event, NET_EVENT_IPV4_ADDR_ADD);
	net_mgmt_add_event_callback(&ipv4_cb);

	err = net_mgmt(NET_REQUEST_WIFI_SCAN, iface, NULL, 0);
	if (err) {
		LOG_ERR("scan request failed (%d)", err);
		return 0;
	}
	k_sem_take(&scan_done, K_SECONDS(30));
	LOG_INF("scan done, %d networks", found);

	if (sizeof(CONFIG_INTUITIV_WIFI_SSID) == 1) {
		return 0;
	}

	struct wifi_connect_req_params p = {
		.ssid = CONFIG_INTUITIV_WIFI_SSID,
		.ssid_length = sizeof(CONFIG_INTUITIV_WIFI_SSID) - 1,
		.psk = CONFIG_INTUITIV_WIFI_PSK,
		.psk_length = sizeof(CONFIG_INTUITIV_WIFI_PSK) - 1,
		.security = sizeof(CONFIG_INTUITIV_WIFI_PSK) > 1 ? WIFI_SECURITY_TYPE_PSK
								 : WIFI_SECURITY_TYPE_NONE,
		.band = WIFI_FREQ_BAND_2_4_GHZ,
		.channel = WIFI_CHANNEL_ANY,
		.mfp = WIFI_MFP_OPTIONAL,
	};

	LOG_INF("joining %s", CONFIG_INTUITIV_WIFI_SSID);
	err = net_mgmt(NET_REQUEST_WIFI_CONNECT, iface, &p, sizeof(p));
	if (err) {
		LOG_ERR("connect request failed (%d)", err);
		return 0;
	}
	if (k_sem_take(&connected, K_SECONDS(30))) {
		LOG_ERR("not connected after 30 s");
		return 0;
	}
	net_dhcpv4_start(iface);
	if (k_sem_take(&bound, K_SECONDS(30))) {
		LOG_ERR("no DHCP address after 30 s");
		return 0;
	}
	ping(iface, "8.8.8.8", 4);
	return 0;
}
```

## src/whd_resources.c
```c
/*
 * SPDX-License-Identifier: Apache-2.0
 *
 * Wi-Fi firmware for WHD (CONFIG_AIROC_WIFI_CUSTOM, RESOURCE_READ_FROM_C_FILE).
 * The 43430 A0 firmware has its CLM built in, so the CLM blob is empty and
 * WHD skips the download.
 */

#include "wiced_resource.h"

const unsigned char wifi_firmware_image_data[] __aligned(4) = {
#include "wifi_fw.inc"
};

const resource_hnd_t wifi_firmware_image = {RESOURCE_IN_MEMORY,
					    sizeof(wifi_firmware_image_data),
					    {.mem = {(const char *)wifi_firmware_image_data}}};

const unsigned char wifi_firmware_clm_blob_data[1];

const resource_hnd_t wifi_firmware_clm_blob = {
	RESOURCE_IN_MEMORY, 0, {.mem = {(const char *)wifi_firmware_clm_blob_data}}};
```
