## CMakeLists.txt
```
# SPDX-License-Identifier: Apache-2.0

cmake_minimum_required(VERSION 3.20.0)
find_package(Zephyr REQUIRED HINTS $ENV{ZEPHYR_BASE})
project(pilot_wire)

target_sources(app PRIVATE src/main.c src/pilot_wire.c src/pilot_wire_logic.c)
```

## Kconfig
```
# SPDX-License-Identifier: Apache-2.0

config PILOT_WIRE_SIM_ZC
	bool "Simulate the 50 Hz zero-cross signal"
	help
	  Bench test without mains: a 10 ms timer replaces the PC7 zero-cross
	  interrupt. The output logic runs as on mains, and the enabled
	  half-wave counts are logged every 10 s.

config PILOT_WIRE_INVERT_POLARITY
	bool "Swap positive and negative half-waves"
	help
	  Verified on mains: PC7 high is the negative half-wave on P2, which
	  is the default. Enable this only if Hors-gel and Arret come out
	  swapped on another installation.

source "Kconfig.zephyr"
```

## prj.conf
```kconfig
CONFIG_GPIO=y
CONFIG_LOG=y

CONFIG_BT=y
CONFIG_BT_PERIPHERAL=y
CONFIG_BT_SMP=y
CONFIG_BT_SMP_APP_PAIRING_ACCEPT=y
# A peer that lost its bond can pair again, still only inside the window
CONFIG_BT_SMP_ALLOW_UNAUTH_OVERWRITE=y
CONFIG_BT_MAX_PAIRED=4
# Outside pairing mode only bonded peers connect. GAP limited discoverable: 180 s max
CONFIG_BT_FILTER_ACCEPT_LIST=y
CONFIG_BT_LIM_ADV_TIMEOUT=180
CONFIG_BT_SETTINGS=y
CONFIG_SETTINGS=y
CONFIG_BT_DEVICE_NAME="Intuitiv"
# settings_load() and settings_save_one() from the GATT write handler
CONFIG_MAIN_STACK_SIZE=2048
CONFIG_SYSTEM_WORKQUEUE_STACK_SIZE=2048
CONFIG_BT_RX_STACK_SIZE=2048

CONFIG_BT_DIS=y
CONFIG_BT_DIS_MANUF_NAME_STR="vendor"
CONFIG_BT_DIS_MODEL_NUMBER_STR="Intuitiv"
CONFIG_BT_DIS_PNP=n
```

## boards/intuitiv.conf
```kconfig
# AP6212 (BCM4343A0). Patchram not committed: see README. Relative to this dir
CONFIG_BT_AIROC=y
CONFIG_BT_AIROC_CUSTOM=y
CONFIG_AIROC_CUSTOM_FIRMWARE_HCD_BLOB="../bluetooth/bcm43438a0.hcd"
```

## src/main.c
```c
/*
 * SPDX-License-Identifier: Apache-2.0
 *
 * Pilot-wire heater control over Bluetooth LE: one custom GATT service with
 * a Mode characteristic (enum pw_mode as uint8), read / write / notify.
 * Writes need an encrypted (bonded) link.
 *
 * Pairing follows GAP: a 3 s press on the middle button (sw0) enters limited
 * discoverable mode for 180 s, the blue LED blinks and Just Works pairing is
 * accepted. Outside it, the board is non-discoverable and only bonded peers
 * may connect (filter accept list). A press on the hidden button (sw1) erases
 * every bond. With no bond, the board enters pairing mode on its own.
 */

#include <zephyr/kernel.h>
#include <zephyr/drivers/gpio.h>
#include <zephyr/logging/log.h>
#include <zephyr/settings/settings.h>
#include <zephyr/bluetooth/bluetooth.h>
#include <zephyr/bluetooth/conn.h>
#include <zephyr/bluetooth/gatt.h>
#include <zephyr/bluetooth/uuid.h>

#include "pilot_wire.h"

LOG_MODULE_REGISTER(main, LOG_LEVEL_INF);

#define LONG_PRESS   K_SECONDS(3)
#define PAIRING_TIME K_SECONDS(CONFIG_BT_LIM_ADV_TIMEOUT)
#define BLINK_MS     250

/* 6f1e0001-5b2c-4d8a-9c3e-2a7b41c0d5e1, Mode is ...0002 */
#define PW_SVC_UUID_VAL  BT_UUID_128_ENCODE(0x6f1e0001, 0x5b2c, 0x4d8a, 0x9c3e, 0x2a7b41c0d5e1)
#define PW_MODE_UUID_VAL BT_UUID_128_ENCODE(0x6f1e0002, 0x5b2c, 0x4d8a, 0x9c3e, 0x2a7b41c0d5e1)

static const struct bt_uuid_128 pw_svc_uuid = BT_UUID_INIT_128(PW_SVC_UUID_VAL);
static const struct bt_uuid_128 pw_mode_uuid = BT_UUID_INIT_128(PW_MODE_UUID_VAL);

static uint8_t mode = PW_CONFORT;
static atomic_t pairing;

static const struct gpio_dt_spec pair_button = GPIO_DT_SPEC_GET(DT_ALIAS(sw0), gpios);
static const struct gpio_dt_spec erase_button = GPIO_DT_SPEC_GET(DT_ALIAS(sw1), gpios);
static const struct gpio_dt_spec led_red = GPIO_DT_SPEC_GET(DT_ALIAS(led0), gpios);
static const struct gpio_dt_spec led_blue = GPIO_DT_SPEC_GET(DT_ALIAS(led2), gpios);
static struct gpio_callback pair_cb, erase_cb;

static int mode_set(const char *name, size_t len, settings_read_cb read_cb, void *cb_arg)
{
	uint8_t val;

	if (strcmp(name, "mode") || len != 1 || read_cb(cb_arg, &val, 1) != 1 ||
	    val >= PW_MODE_COUNT) {
		return -EINVAL;
	}
	mode = val;
	return 0;
}
SETTINGS_STATIC_HANDLER_DEFINE(pw, "pw", NULL, mode_set, NULL, NULL);

static ssize_t read_mode(struct bt_conn *conn, const struct bt_gatt_attr *attr, void *buf,
			 uint16_t len, uint16_t offset)
{
	return bt_gatt_attr_read(conn, attr, buf, len, offset, &mode, sizeof(mode));
}

static ssize_t write_mode(struct bt_conn *conn, const struct bt_gatt_attr *attr, const void *buf,
			  uint16_t len, uint16_t offset, uint8_t flags);

/* clang-format off */
BT_GATT_SERVICE_DEFINE(pw_svc,
	BT_GATT_PRIMARY_SERVICE(&pw_svc_uuid),
	BT_GATT_CHARACTERISTIC(&pw_mode_uuid.uuid,
			       BT_GATT_CHRC_READ | BT_GATT_CHRC_WRITE | BT_GATT_CHRC_NOTIFY,
			       BT_GATT_PERM_READ | BT_GATT_PERM_WRITE_ENCRYPT,
			       read_mode, write_mode, NULL),
	BT_GATT_CCC(NULL, BT_GATT_PERM_READ | BT_GATT_PERM_WRITE_ENCRYPT),
);
/* clang-format on */

static ssize_t write_mode(struct bt_conn *conn, const struct bt_gatt_attr *attr, const void *buf,
			  uint16_t len, uint16_t offset, uint8_t flags)
{
	uint8_t val;
	int err;

	if (offset) {
		return BT_GATT_ERR(BT_ATT_ERR_INVALID_OFFSET);
	}
	if (len != 1) {
		return BT_GATT_ERR(BT_ATT_ERR_INVALID_ATTRIBUTE_LEN);
	}
	val = *(const uint8_t *)buf;
	if (val >= PW_MODE_COUNT) {
		return BT_GATT_ERR(BT_ATT_ERR_VALUE_NOT_ALLOWED);
	}

	mode = val;
	pilot_wire_set(val);
	LOG_INF("mode %u", val);

	err = settings_save_one("pw/mode", &val, 1);
	if (err) {
		LOG_ERR("mode save failed (%d)", err);
	}
	bt_gatt_notify(NULL, &pw_svc.attrs[1], &val, 1);
	return len;
}

static const struct bt_data ad_pairing[] = {
	BT_DATA_BYTES(BT_DATA_FLAGS, (BT_LE_AD_LIMITED | BT_LE_AD_NO_BREDR)),
	BT_DATA_BYTES(BT_DATA_UUID128_ALL, PW_SVC_UUID_VAL),
};

/* Non-discoverable: no UUID either, so no host offers to set up the board */
static const struct bt_data ad_normal[] = {
	BT_DATA_BYTES(BT_DATA_FLAGS, BT_LE_AD_NO_BREDR),
};

static const struct bt_data sd[] = {
	BT_DATA(BT_DATA_NAME_COMPLETE, CONFIG_BT_DEVICE_NAME, sizeof(CONFIG_BT_DEVICE_NAME) - 1),
};

static void accept_bond(const struct bt_bond_info *info, void *user_data)
{
	if (bt_le_filter_accept_list_add(&info->addr)) {
		LOG_ERR("accept list full");
	}
}

static void count_conn(struct bt_conn *conn, void *data)
{
	(*(int *)data)++;
}

static void drop_conn(struct bt_conn *conn, void *data)
{
	bt_conn_disconnect(conn, BT_HCI_ERR_REMOTE_USER_TERM_CONN);
}

/*
 * The accept list cannot change while advertising: rebuild it on every start.
 * The BCM4343A0 stops taking connections after it advertised during a link,
 * so with a link up, wait: .recycled restarts advertising after it.
 */
static void adv_restart(struct k_work *work)
{
	int links = 0;
	int err;

	bt_conn_foreach(BT_CONN_TYPE_LE, count_conn, &links);
	if (links) {
		return;
	}
	bt_le_adv_stop();
	bt_le_filter_accept_list_clear();
	bt_foreach_bond(BT_ID_DEFAULT, accept_bond, NULL);

	if (atomic_get(&pairing)) {
		err = bt_le_adv_start(BT_LE_ADV_CONN_FAST_1, ad_pairing, ARRAY_SIZE(ad_pairing), sd,
				      ARRAY_SIZE(sd));
	} else {
		err = bt_le_adv_start(
			BT_LE_ADV_PARAM(BT_LE_ADV_OPT_CONN | BT_LE_ADV_OPT_FILTER_CONN,
					BT_GAP_ADV_SLOW_INT_MIN, BT_GAP_ADV_SLOW_INT_MAX, NULL),
			ad_normal, ARRAY_SIZE(ad_normal), NULL, 0);
	}
	if (err) {
		LOG_ERR("advertising failed (%d)", err);
	}
}
static K_WORK_DEFINE(adv_work, adv_restart);

static void start_adv(void)
{
	k_work_submit(&adv_work);
}

static void blink(struct k_timer *t)
{
	gpio_pin_toggle_dt(&led_blue);
}
static K_TIMER_DEFINE(blink_timer, blink, NULL);

static void pairing_end(struct k_work *work)
{
	if (atomic_cas(&pairing, 1, 0)) {
		k_timer_stop(&blink_timer);
		gpio_pin_set_dt(&led_blue, 0);
		LOG_INF("pairing mode off");
		start_adv();
	}
}
static K_WORK_DELAYABLE_DEFINE(pairing_end_work, pairing_end);

static void pairing_start(void)
{
	atomic_set(&pairing, 1);
	gpio_pin_set_dt(&led_red, 0);
	k_timer_start(&blink_timer, K_NO_WAIT, K_MSEC(BLINK_MS));
	k_work_reschedule(&pairing_end_work, PAIRING_TIME);
	LOG_INF("pairing mode for %d s", CONFIG_BT_LIM_ADV_TIMEOUT);
	/*
	 * One link only (see adv_restart): free it for the new host.
	 * ponytail: a bonded host that reconnects first takes the slot back,
	 * press again. Fix with a second link if the controller ever allows it.
	 */
	bt_conn_foreach(BT_CONN_TYPE_LE, drop_conn, NULL);
	start_adv();
}

static void connected(struct bt_conn *conn, uint8_t err)
{
	LOG_INF("connected (%u)", err);
}

static void disconnected(struct bt_conn *conn, uint8_t reason)
{
	LOG_INF("disconnected (0x%02x)", reason);
}

static void security_changed(struct bt_conn *conn, bt_security_t level, enum bt_security_err err)
{
	LOG_INF("security level %d (err %d)", level, err);
}

BT_CONN_CB_DEFINE(conn_callbacks) = {
	.connected = connected,
	.disconnected = disconnected,
	.recycled = start_adv,
	.security_changed = security_changed,
};

static enum bt_security_err pairing_accept(struct bt_conn *conn,
					   const struct bt_conn_pairing_feat *const feat)
{
	if (!atomic_get(&pairing)) {
		LOG_WRN("pairing rejected: hold the middle button 3 s first");
		return BT_SECURITY_ERR_PAIR_NOT_ALLOWED;
	}
	return BT_SECURITY_ERR_SUCCESS;
}

static struct bt_conn_auth_cb auth_cb = {
	.pairing_accept = pairing_accept,
};

static void pairing_complete(struct bt_conn *conn, bool bonded)
{
	LOG_INF("paired (bonded %d)", bonded);
	if (bonded) {
		k_work_reschedule(&pairing_end_work, K_NO_WAIT);
	}
}

static struct bt_conn_auth_info_cb auth_info_cb = {
	.pairing_complete = pairing_complete,
};

static void long_press(struct k_work *work)
{
	if (gpio_pin_get_dt(&pair_button) == 1) {
		pairing_start();
	}
}
static K_WORK_DELAYABLE_DEFINE(long_press_work, long_press);

static void pair_changed(const struct device *dev, struct gpio_callback *cb, uint32_t pins)
{
	if (gpio_pin_get_dt(&pair_button) == 1) {
		k_work_reschedule(&long_press_work, LONG_PRESS);
	} else {
		k_work_cancel_delayable(&long_press_work);
	}
}

/* Red for 1 s, then pairing mode: no bond is left */
static void erase_done(struct k_work *work)
{
	pairing_start();
}
static K_WORK_DELAYABLE_DEFINE(erase_done_work, erase_done);

static void erase(struct k_work *work)
{
	int err;

	if (gpio_pin_get_dt(&erase_button) != 1) {
		return;
	}
	/* Also disconnects the bonded peers */
	err = bt_unpair(BT_ID_DEFAULT, BT_ADDR_LE_ANY);
	LOG_INF("bonds erased (%d)", err);
	gpio_pin_set_dt(&led_red, 1);
	k_work_reschedule(&erase_done_work, K_SECONDS(1));
}
static K_WORK_DELAYABLE_DEFINE(erase_work, erase);

static void erase_pressed(const struct device *dev, struct gpio_callback *cb, uint32_t pins)
{
	k_work_reschedule(&erase_work, K_MSEC(50));
}

static int button_init(const struct gpio_dt_spec *b, struct gpio_callback *cb,
		       gpio_callback_handler_t handler, gpio_flags_t edge)
{
	int err = gpio_pin_configure_dt(b, GPIO_INPUT);

	if (!err) {
		err = gpio_pin_interrupt_configure_dt(b, edge);
	}
	if (!err) {
		gpio_init_callback(cb, handler, BIT(b->pin));
		err = gpio_add_callback_dt(b, cb);
	}
	return err;
}

static void count_bond(const struct bt_bond_info *info, void *user_data)
{
	(*(int *)user_data)++;
}

int main(void)
{
	int err;

	err = bt_enable(NULL);
	if (err) {
		LOG_ERR("Bluetooth init failed (%d)", err);
		return 0;
	}
	/* Bonds, identity and the saved mode */
	settings_load();

	err = pilot_wire_init(mode);
	if (err) {
		LOG_ERR("pilot wire init failed (%d)", err);
		return 0;
	}
	LOG_INF("mode %u", mode);

	bt_conn_auth_cb_register(&auth_cb);
	bt_conn_auth_info_cb_register(&auth_info_cb);

	gpio_pin_configure_dt(&led_red, GPIO_OUTPUT_INACTIVE);
	gpio_pin_configure_dt(&led_blue, GPIO_OUTPUT_INACTIVE);
	if (button_init(&pair_button, &pair_cb, pair_changed, GPIO_INT_EDGE_BOTH)) {
		LOG_ERR("pairing button unavailable");
	}
	if (button_init(&erase_button, &erase_cb, erase_pressed, GPIO_INT_EDGE_TO_ACTIVE)) {
		LOG_ERR("erase button unavailable");
	}

	int bonds = 0;

	bt_foreach_bond(BT_ID_DEFAULT, count_bond, &bonds);
	LOG_INF("%d bond(s), advertising as %s", bonds, CONFIG_BT_DEVICE_NAME);
	if (bonds) {
		start_adv();
	} else {
		pairing_start();
	}
	return 0;
}
```

## src/pilot_wire.c
```c
/*
 * SPDX-License-Identifier: Apache-2.0
 *
 * Pilot-wire output. The MOC3063 fires at the next zero crossing after its
 * LED turns on, and the triac stops at the next crossing after the LED turns
 * off. So the LED is set mid half-wave to "is the next half-wave wanted".
 */

#include <zephyr/kernel.h>
#include <zephyr/drivers/gpio.h>
#include <zephyr/logging/log.h>

#include "pilot_wire.h"

LOG_MODULE_REGISTER(pilot_wire, LOG_LEVEL_INF);

#define ZC_DELAY_MS 5  /* mid half-wave at 50 Hz */
#define ZC_LOST_MS  40 /* two full mains periods */
#define TICK_MS     100
#define STATS_TICKS 100 /* 10 s */

static const struct gpio_dt_spec opto = GPIO_DT_SPEC_GET(DT_PATH(zephyr_user), opto_gpios);

/* Uptimes in 32-bit ms, so the ISRs read them whole */
static atomic_t cur_mode;
static atomic_t mode_start;
static atomic_t last_zc;
static enum pw_half cur_half;
static atomic_t count[2];

static uint32_t cycle_ms(void)
{
	return (k_uptime_get_32() - (uint32_t)atomic_get(&mode_start)) % PW_CYCLE_MS;
}

/* Mid half-wave: arm (or not) the optotriac for the next one */
static void mid_half(struct k_timer *t)
{
	enum pw_half next = cur_half == PW_HALF_POS ? PW_HALF_NEG : PW_HALF_POS;
	bool on = pw_conduct(atomic_get(&cur_mode), next, cycle_ms());

	gpio_pin_set_dt(&opto, on);
	if (on) {
		atomic_inc(&count[next]);
	}
}
static K_TIMER_DEFINE(mid_timer, mid_half, NULL);

static void zero_cross(enum pw_half starting)
{
	if (IS_ENABLED(CONFIG_PILOT_WIRE_INVERT_POLARITY)) {
		starting = starting == PW_HALF_POS ? PW_HALF_NEG : PW_HALF_POS;
	}
	cur_half = starting;
	atomic_set(&last_zc, k_uptime_get_32());
	k_timer_start(&mid_timer, K_MSEC(ZC_DELAY_MS), K_NO_WAIT);
}

#ifdef CONFIG_PILOT_WIRE_SIM_ZC
static void sim_zc(struct k_timer *t)
{
	static enum pw_half half;

	half = half == PW_HALF_POS ? PW_HALF_NEG : PW_HALF_POS;
	zero_cross(half);
}
static K_TIMER_DEFINE(sim_timer, sim_zc, NULL);
#else
static const struct gpio_dt_spec zc = GPIO_DT_SPEC_GET(DT_PATH(zephyr_user), zero_cross_gpios);
static struct gpio_callback zc_cb;

static void zc_isr(const struct device *dev, struct gpio_callback *cb, uint32_t pins)
{
	/* Verified on mains: PC7 high is the negative half-wave on P2 */
	zero_cross(gpio_pin_get_dt(&zc) ? PW_HALF_NEG : PW_HALF_POS);
}
#endif

static bool zc_present(void)
{
	return k_uptime_get_32() - (uint32_t)atomic_get(&last_zc) <= ZC_LOST_MS;
}

/* No mains (bench): only full-wave orders can be expressed, as LED on */
static void tick(struct k_work *work)
{
	static int ticks;
	static int was_present = -1;
	bool present = zc_present();

	if (present != was_present) {
		was_present = present;
		if (present) {
			LOG_INF("zero-cross present");
		} else {
			LOG_WRN("no zero-cross: half-wave orders fall back to Confort");
		}
	}
	if (!present) {
		enum pw_mode mode = atomic_get(&cur_mode);
		uint32_t t = cycle_ms();

		gpio_pin_set_dt(&opto, pw_conduct(mode, PW_HALF_POS, t) &&
					       pw_conduct(mode, PW_HALF_NEG, t));
	}

	if (++ticks == STATS_TICKS) {
		ticks = 0;
		LOG_INF("mode %ld, half-waves on: +%ld -%ld", atomic_get(&cur_mode),
			atomic_set(&count[PW_HALF_POS], 0), atomic_set(&count[PW_HALF_NEG], 0));
	}
	k_work_schedule(k_work_delayable_from_work(work), K_MSEC(TICK_MS));
}
static K_WORK_DELAYABLE_DEFINE(tick_work, tick);

void pilot_wire_set(enum pw_mode mode)
{
	atomic_set(&mode_start, k_uptime_get_32());
	atomic_set(&cur_mode, mode);
}

int pilot_wire_init(enum pw_mode mode)
{
	int err;

	pilot_wire_set(mode);
	atomic_set(&last_zc, k_uptime_get_32() - 1000U);

	err = gpio_pin_configure_dt(&opto, GPIO_OUTPUT_INACTIVE);
	if (err) {
		return err;
	}

#ifdef CONFIG_PILOT_WIRE_SIM_ZC
	LOG_WRN("simulated zero-cross");
	k_timer_start(&sim_timer, K_MSEC(10), K_MSEC(10));
#else
	err = gpio_pin_configure_dt(&zc, GPIO_INPUT);
	if (err) {
		return err;
	}
	gpio_init_callback(&zc_cb, zc_isr, BIT(zc.pin));
	err = gpio_add_callback_dt(&zc, &zc_cb);
	if (err) {
		return err;
	}
	err = gpio_pin_interrupt_configure_dt(&zc, GPIO_INT_EDGE_BOTH);
	if (err) {
		return err;
	}
#endif

	/* Give the zero-cross time to show up before calling it lost */
	k_work_schedule(&tick_work, K_MSEC(2 * ZC_LOST_MS));
	return 0;
}
```

## src/pilot_wire.h
```c
/*
 * SPDX-License-Identifier: Apache-2.0
 */

#ifndef PILOT_WIRE_H_
#define PILOT_WIRE_H_

#include "pilot_wire_logic.h"

int pilot_wire_init(enum pw_mode mode);
void pilot_wire_set(enum pw_mode mode);

#endif /* PILOT_WIRE_H_ */
```

## src/pilot_wire_logic.c
```c
/*
 * SPDX-License-Identifier: Apache-2.0
 */

#include "pilot_wire_logic.h"

bool pw_conduct(enum pw_mode mode, enum pw_half half, uint32_t t_ms)
{
	switch (mode) {
	case PW_ECO:
		return true;
	case PW_HORS_GEL:
		return half == PW_HALF_NEG;
	case PW_ARRET:
		return half == PW_HALF_POS;
	case PW_CONFORT_M1:
		return t_ms % PW_CYCLE_MS < 3000U;
	case PW_CONFORT_M2:
		return t_ms % PW_CYCLE_MS < 7000U;
	default:
		return false;
	}
}
```

## src/pilot_wire_logic.h
```c
/*
 * SPDX-License-Identifier: Apache-2.0
 *
 * Pilot-wire ("fil pilote") orders, as seen on the output (P2 against neutral).
 */

#ifndef PILOT_WIRE_LOGIC_H_
#define PILOT_WIRE_LOGIC_H_

#include <stdbool.h>
#include <stdint.h>

/* Values of the Bluetooth Mode characteristic: keep them stable */
enum pw_mode {
	PW_CONFORT = 0,    /* 0 V */
	PW_ECO = 1,        /* full wave */
	PW_HORS_GEL = 2,   /* negative half-waves */
	PW_ARRET = 3,      /* positive half-waves */
	PW_CONFORT_M1 = 4, /* full wave 3 s every 300 s */
	PW_CONFORT_M2 = 5, /* full wave 7 s every 300 s */
	PW_MODE_COUNT,
};

enum pw_half {
	PW_HALF_POS,
	PW_HALF_NEG,
};

#define PW_CYCLE_MS 300000U

/*
 * Whether the triac conducts during `half`, `t_ms` milliseconds into the
 * 300 s Confort -1/-2 cycle.
 */
bool pw_conduct(enum pw_mode mode, enum pw_half half, uint32_t t_ms);

#endif /* PILOT_WIRE_LOGIC_H_ */
```
