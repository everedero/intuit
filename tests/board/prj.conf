## CMakeLists.txt
```
# SPDX-License-Identifier: Apache-2.0

cmake_minimum_required(VERSION 3.20.0)
find_package(Zephyr REQUIRED HINTS $ENV{ZEPHYR_BASE})
project(board_test)

target_sources(app PRIVATE src/gpio.c src/flash.c)
target_sources_ifdef(CONFIG_BT app PRIVATE src/bt.c)
```

## prj.conf
```kconfig
CONFIG_ZTEST=y
CONFIG_GPIO=y
CONFIG_FLASH=y
```

## bt.conf
```kconfig
CONFIG_BT=y
CONFIG_BT_PERIPHERAL=y
CONFIG_BT_DEVICE_NAME="Intuitiv test"
CONFIG_MAIN_STACK_SIZE=2048
# AP6212 (BCM4343A0). Patchram not committed: see README. Relative to this dir
CONFIG_BT_AIROC=y
CONFIG_BT_AIROC_CUSTOM=y
CONFIG_AIROC_CUSTOM_FIRMWARE_HCD_BLOB="../../apps/bluetooth/bcm43438a0.hcd"
```

## boards/intuitiv.conf
```kconfig
# flash_read_jedec_id()
CONFIG_FLASH_JESD216_API=y
```

## src/bt.c
```c
/*
 * SPDX-License-Identifier: Apache-2.0
 *
 * AP6212 Bluetooth: patchram download (bt_enable), public identity address,
 * connectable advertising start and stop.
 */

#include <zephyr/kernel.h>
#include <zephyr/bluetooth/bluetooth.h>
#include <zephyr/ztest.h>

static const struct bt_data ad[] = {
	BT_DATA_BYTES(BT_DATA_FLAGS, BT_LE_AD_GENERAL | BT_LE_AD_NO_BREDR),
};

static void *bt_setup(void)
{
	zassert_ok(bt_enable(NULL));
	return NULL;
}

ZTEST(board_bt, test_identity)
{
	bt_addr_le_t addr;
	size_t count = 1;

	bt_id_get(&addr, &count);
	zassert_equal(count, 1);
	zassert_false(bt_addr_le_eq(&addr, BT_ADDR_LE_ANY));
	TC_PRINT("identity type %u\n", addr.type);
}

ZTEST(board_bt, test_advertise)
{
	zassert_ok(bt_le_adv_start(BT_LE_ADV_CONN_FAST_1, ad, ARRAY_SIZE(ad), NULL, 0));
	k_sleep(K_MSEC(500));
	zassert_ok(bt_le_adv_stop());
}

ZTEST_SUITE(board_bt, NULL, bt_setup, NULL, NULL, NULL);
```

## src/flash.c
```c
/*
 * SPDX-License-Identifier: Apache-2.0
 *
 * SPI NOR: geometry, JEDEC id, and an erase/write/read cycle on one sector
 * that the factory image leaves erased (see README, SPI flash dump).
 */

#include <string.h>
#include <zephyr/kernel.h>
#include <zephyr/drivers/flash.h>
#include <zephyr/ztest.h>

#define FLASH_NODE DT_NODELABEL(spi_flash)

/* native_sim: the flash simulator device is the parent controller */
#if DT_NODE_HAS_COMPAT(FLASH_NODE, soc_nv_flash)
#define FLASH_DEV_NODE DT_PARENT(FLASH_NODE)
#define FLASH_SIZE     DT_REG_SIZE(FLASH_NODE)
#else
#define FLASH_DEV_NODE FLASH_NODE
#define FLASH_SIZE     (DT_PROP(FLASH_NODE, size) / 8)
#endif

/* Erased in the factory dump: data ends at 0x53ffff, resumes at 0x7e0000 */
#define TEST_OFFSET 0x700000
#define SECTOR      4096

static const struct device *const flash = DEVICE_DT_GET(FLASH_DEV_NODE);
static uint8_t buf[SECTOR];

ZTEST(board_flash, test_geometry)
{
	struct flash_pages_info info;

	zassert_true(device_is_ready(flash));
	zassert_equal(FLASH_SIZE, 8 * 1024 * 1024);
	zassert_ok(flash_get_page_info_by_offs(flash, TEST_OFFSET, &info));
	zassert_equal(info.size, SECTOR);
	zassert_equal(info.start_offset, TEST_OFFSET);
}

ZTEST(board_flash, test_jedec_id)
{
#if DT_NODE_HAS_PROP(FLASH_NODE, jedec_id)
	uint8_t id[3];
	const uint8_t want[] = DT_PROP(FLASH_NODE, jedec_id);

	zassert_ok(flash_read_jedec_id(flash, id));
	zassert_mem_equal(id, want, sizeof(id));
#else
	ztest_test_skip();
#endif
}

ZTEST(board_flash, test_erase_write_read)
{
	zassert_ok(flash_erase(flash, TEST_OFFSET, SECTOR));
	zassert_ok(flash_read(flash, TEST_OFFSET, buf, SECTOR));
	for (size_t i = 0; i < SECTOR; i++) {
		zassert_equal(buf[i], 0xff, "not erased at %zu", i);
	}

	for (size_t i = 0; i < SECTOR; i++) {
		buf[i] = (uint8_t)(i * 7 + 3);
	}
	zassert_ok(flash_write(flash, TEST_OFFSET, buf, SECTOR));
	memset(buf, 0, SECTOR);
	zassert_ok(flash_read(flash, TEST_OFFSET, buf, SECTOR));
	for (size_t i = 0; i < SECTOR; i++) {
		zassert_equal(buf[i], (uint8_t)(i * 7 + 3), "bad byte at %zu", i);
	}

	/* Leave the sector erased, as found */
	zassert_ok(flash_erase(flash, TEST_OFFSET, SECTOR));
}

ZTEST_SUITE(board_flash, NULL, NULL, NULL, NULL, NULL);
```

## src/gpio.c
```c
/*
 * SPDX-License-Identifier: Apache-2.0
 *
 * RGB LED and buttons. On native_sim the emulated GPIO controller lets the
 * test press the buttons and see the LED pin levels; on the board nobody
 * presses them, so they must read released.
 */

#include <zephyr/kernel.h>
#include <zephyr/drivers/gpio.h>
#include <zephyr/ztest.h>

#ifdef CONFIG_GPIO_EMUL
#include <zephyr/drivers/gpio/gpio_emul.h>
#endif

static const struct gpio_dt_spec leds[] = {
	GPIO_DT_SPEC_GET(DT_ALIAS(led0), gpios),
	GPIO_DT_SPEC_GET(DT_ALIAS(led1), gpios),
	GPIO_DT_SPEC_GET(DT_ALIAS(led2), gpios),
};

static const struct gpio_dt_spec buttons[] = {
	GPIO_DT_SPEC_GET(DT_ALIAS(sw0), gpios),
	GPIO_DT_SPEC_GET(DT_ALIAS(sw1), gpios),
};

ZTEST(board_leds, test_set_and_read_back)
{
	ARRAY_FOR_EACH(leds, i) {
		const struct gpio_dt_spec *led = &leds[i];

		zassert_true(gpio_is_ready_dt(led));
		zassert_ok(gpio_pin_configure_dt(led, GPIO_OUTPUT_INACTIVE | GPIO_INPUT));
		for (int on = 1; on >= 0; on--) {
			zassert_ok(gpio_pin_set_dt(led, on));
			zassert_equal(gpio_pin_get_dt(led), on, "led%zu", i);
#ifdef CONFIG_GPIO_EMUL
			/* Active low: lit means the pin is driven low */
			zassert_equal(gpio_emul_output_get(led->port, led->pin), !on);
#endif
		}
	}
}

ZTEST_SUITE(board_leds, NULL, NULL, NULL, NULL, NULL);

static K_SEM_DEFINE(pressed, 0, 1);

static void on_press(const struct device *dev, struct gpio_callback *cb, uint32_t pins)
{
	k_sem_give(&pressed);
}

ZTEST(board_buttons, test_released_and_irq)
{
	ARRAY_FOR_EACH(buttons, i) {
		const struct gpio_dt_spec *btn = &buttons[i];
		struct gpio_callback cb;

		zassert_true(gpio_is_ready_dt(btn));
		zassert_ok(gpio_pin_configure_dt(btn, GPIO_INPUT));
		zassert_equal(gpio_pin_get_dt(btn), 0, "sw%zu reads pressed", i);

		gpio_init_callback(&cb, on_press, BIT(btn->pin));
		zassert_ok(gpio_add_callback_dt(btn, &cb));
		zassert_ok(gpio_pin_interrupt_configure_dt(btn, GPIO_INT_EDGE_TO_ACTIVE));
		k_sem_reset(&pressed);
#ifdef CONFIG_GPIO_EMUL
		zassert_ok(gpio_emul_input_set(btn->port, btn->pin, 1));
		zassert_ok(k_sem_take(&pressed, K_MSEC(100)), "sw%zu: no interrupt", i);
		zassert_equal(gpio_pin_get_dt(btn), 1);
		zassert_ok(gpio_emul_input_set(btn->port, btn->pin, 0));
#else
		/* Released: no edge, so no interrupt */
		zassert_not_equal(k_sem_take(&pressed, K_MSEC(100)), 0, "sw%zu bounced", i);
#endif
		zassert_ok(gpio_pin_interrupt_configure_dt(btn, GPIO_INT_DISABLE));
		zassert_ok(gpio_remove_callback_dt(btn, &cb));
	}
}

ZTEST_SUITE(board_buttons, NULL, NULL, NULL, NULL, NULL);
```
